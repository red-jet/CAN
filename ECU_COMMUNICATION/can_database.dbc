VERSION ""

NS_ :

BS_:

BU_:
VAL_TABLE_ Light_Contol 1 "Light ON" 0 "Light OFF" ;

BO_ 291 FLCM_RLCM: 1 Vector__XXX
 SG_ FLCM_RLCM_ON_OFF : 0|1@1+ (1,0) [0|1] "" Vector__XXX

BA_DEF_  "BusType" STRING ;
BA_DEF_DEF_  "BusType" "CAN";
VAL_ 291 FLCM_RLCM_ON_OFF 1 "Light ON" 0 "Light OFF" ;
