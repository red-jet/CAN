VERSION ""

NS_ :

BS_:

BU_: RLCM FLCM

BO_ 64 CentralLock_Message: 1 Vector__XXX
 SG_ CentralLock : 0|1@1+ (1,0) [0|1] "" Vector__XXX

BO_ 96 Indicator_Message: 1 Vector__XXX
 SG_ Indicator : 0|2@1+ (1,0) [0|3] ""  RLCM,FLCM

BO_ 86 Light_Message: 1 Vector__XXX
 SG_ Light : 0|1@1+ (1,0) [0|1] ""  RLCM,FLCM

BA_DEF_  "BusType" STRING ;
BA_DEF_DEF_  "BusType" "CAN";
VAL_ 64 CentralLock 1 "CentralLock_Unlock" 0 "CentralLock_Lock" ;
VAL_ 96 Indicator 3 "Indicator_Parking_ON" 2 "Indicator_Right_ON" 1 "Indicator_Left_ON" 0 "Indicator_OFF" ;
VAL_ 86 Light 1 "Light_ON" 0 "Light_OFF" ;
